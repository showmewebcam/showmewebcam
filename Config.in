## Config.in
```kconfig
source "$BR2_EXTERNAL_PICAM_PATH/package/piwebcam/Config.in"
source "$BR2_EXTERNAL_PICAM_PATH/package/soft-hwclock/Config.in"
source "$BR2_EXTERNAL_PICAM_PATH/package/camera-control/Config.in"
source "$BR2_EXTERNAL_PICAM_PATH/package/mongoose-pi/Config.in"
source "$BR2_EXTERNAL_PICAM_PATH/package/picam-web/Config.in"
source "$BR2_EXTERNAL_PICAM_PATH/package/rpic-raspimjpeg/Config.in"
```

## configs/defaultpi0w_defconfig
```kconfig
BR2_arm=y
BR2_arm1176jzf_s=y
# BR2_ARM_EABIHF is not set

# Linux headers same as kernel, a 5.4 series
BR2_KERNEL_HEADERS_5_4=y

BR2_TOOLCHAIN_BUILDROOT_CXX=y

BR2_LINUX_KERNEL=y
BR2_LINUX_KERNEL_CUSTOM_TARBALL=y
BR2_LINUX_KERNEL_CUSTOM_TARBALL_LOCATION="$(call github,raspberrypi,linux,c5e512a329ac7a0bfdd5f53477f4300723618db5)/linux-c5e512a329ac7a0bfdd5f53477f4300723618db5.tar.gz"
# BR2_LINUX_KERNEL_DEFCONFIG is not set
BR2_LINUX_KERNEL_USE_CUSTOM_CONFIG=y
BR2_LINUX_KERNEL_CUSTOM_CONFIG_FILE="$(BR2_EXTERNAL_PICAM_PATH)/board/raspberrypi0cam/defaultpi0w.config $(BR2_EXTERNAL_PICAM_PATH)/board/raspberrypi0cam/raspberrypi0cam.config"
BR2_LINUX_KERNEL_DTS_SUPPORT=y
BR2_LINUX_KERNEL_INTREE_DTS_NAME="bcm2708-rpi-zero-w"
BR2_LINUX_KERNEL_NEEDS_HOST_OPENSSL=y

BR2_PACKAGE_RPI_FIRMWARE=y

# Required tools to create the SD image
BR2_PACKAGE_HOST_DOSFSTOOLS=y
BR2_PACKAGE_HOST_GENIMAGE=y
BR2_PACKAGE_HOST_MTOOLS=y

# Filesystem / image
BR2_TARGET_ROOTFS_EXT2=y
BR2_TARGET_ROOTFS_EXT2_4=y
BR2_TARGET_ROOTFS_EXT2_SIZE="120M"
# BR2_TARGET_ROOTFS_TAR is not set
# BR2_ROOTFS_POST_BUILD_SCRIPT is not set
# BR2_ROOTFS_POST_IMAGE_SCRIPT is not set
# BR2_ROOTFS_POST_SCRIPT_ARGS is not set
```

## configs/raspberry0cam_defconfig
```kconfig
BR2_arm=y
BR2_arm1176jzf_s=y
BR2_PACKAGE_HOST_LINUX_HEADERS_CUSTOM_4_19=y
BR2_TOOLCHAIN_BUILDROOT_CXX=y
BR2_TARGET_GENERIC_ROOT_PASSWD="root"
BR2_ROOTFS_OVERLAY="board/raspberrypi0cam/rootfs"
BR2_ROOTFS_POST_BUILD_SCRIPT="board/raspberrypi0cam/post-build.sh"
BR2_ROOTFS_POST_IMAGE_SCRIPT="board/raspberrypi0cam/post-image.sh"
BR2_LINUX_KERNEL=y
BR2_LINUX_KERNEL_CUSTOM_TARBALL=y
BR2_LINUX_KERNEL_CUSTOM_TARBALL_LOCATION="$(call github,raspberrypi,linux,4f2a4cc501c428c940549f39d5562e60404ac4f7)/linux-4f2a4cc501c428c940549f39d5562e60404ac4f7.tar.gz"
BR2_LINUX_KERNEL_DEFCONFIG="bcmrpi"
BR2_LINUX_KERNEL_DTS_SUPPORT=y
BR2_LINUX_KERNEL_INTREE_DTS_NAME="bcm2708-rpi-zero-w"
BR2_LINUX_KERNEL_NEEDS_HOST_OPENSSL=y
BR2_PACKAGE_RPI_FIRMWARE=y
BR2_PACKAGE_RPI_FIRMWARE_X=y
BR2_PACKAGE_DROPBEAR=y
# BR2_PACKAGE_DROPBEAR_CLIENT is not set
BR2_PACKAGE_WPA_SUPPLICANT=y
BR2_TARGET_ROOTFS_EXT2=y
BR2_TARGET_ROOTFS_EXT2_4=y
BR2_TARGET_ROOTFS_EXT2_SIZE="120M"
# BR2_TARGET_ROOTFS_TAR is not set
BR2_PACKAGE_HOST_DOSFSTOOLS=y
BR2_PACKAGE_HOST_GENIMAGE=y
BR2_PACKAGE_HOST_MTOOLS=y
```

## configs/raspberrypi0cam_defconfig
```kconfig
### Custom settings
BR2_TARGET_GENERIC_HOSTNAME="piwebcam"
BR2_TARGET_GENERIC_ISSUE="Your webcam at your service!"
BR2_TARGET_GENERIC_ROOT_PASSWD="root"

# Custom packages
BR2_PACKAGE_LIBV4L=y
BR2_PACKAGE_LIBNL=y
BR2_PACKAGE_PIWEBCAM=y
BR2_PACKAGE_SYSTEMD_ANALYZE=y

# Enable camera module
BR2_PACKAGE_RPI_FIRMWARE_X=y

# Enable LZ4 compressing in Squash filesystem
BR2_LINUX_KERNEL_LZ4=y
BR2_TARGET_ROOTFS_SQUASHFS=y
BR2_TARGET_ROOTFS_SQUASHFS4_LZ4=y

# Build rootfs overlay and post scripts
BR2_ROOTFS_OVERLAY="$(BR2_EXTERNAL_PICAM_PATH)/board/raspberrypicam/rootfs"
BR2_ROOTFS_POST_BUILD_SCRIPT="$(BR2_EXTERNAL_PICAM_PATH)/board/raspberrypicam/post-build.sh"
BR2_ROOTFS_POST_IMAGE_SCRIPT="$(BR2_EXTERNAL_PICAM_PATH)/board/raspberrypicam/post-image.sh"
BR2_ROOTFS_POST_SCRIPT_ARGS="--configure-picam"

# Enable compiler cache
BR2_CCACHE=y
BR2_CCACHE_DIR="$(BASE_DIR)/.ccache"

# Init systemd
BR2_TOOLCHAIN_BUILDROOT_GLIBC=y
BR2_INIT_SYSTEMD=y

# Setup serial port for usb debugging
BR2_TARGET_GENERIC_GETTY_PORT="ttyAMA0"

# Packages removed to optimize boot time
# BR2_PACKAGE_SYSTEMD_PSTORE is not set
# BR2_PACKAGE_SYSTEMD_HOSTNAMED is not set
# BR2_PACKAGE_SYSTEMD_HWDB is not set
# BR2_PACKAGE_SYSTEMD_MYHOSTNAME is not set
# BR2_PACKAGE_SYSTEMD_NETWORKD is not set
# BR2_PACKAGE_SYSTEMD_RESOLVED is not set
# BR2_PACKAGE_SYSTEMD_TIMEDATED is not set
# BR2_PACKAGE_SYSTEMD_TIMESYNCD is not set
# BR2_PACKAGE_SYSTEMD_TMPFILES is not set
# BR2_PACKAGE_SYSTEMD_VCONSOLE is not set
```

## configs/raspberrypi4cam_defconfig
```kconfig
# Raspberrypi 4 defconfig modified for Showmewebcam
BR2_arm=y
BR2_cortex_a72=y
BR2_ARM_FPU_NEON_VFPV4=y

BR2_TOOLCHAIN_BUILDROOT_CXX=y

# Linux headers same as kernel, a 4.19 series (known to work with OTG on pi4)
BR2_PACKAGE_HOST_LINUX_HEADERS_CUSTOM_4_19=y
BR2_LINUX_KERNEL=y
BR2_LINUX_KERNEL_CUSTOM_TARBALL=y
BR2_LINUX_KERNEL_CUSTOM_TARBALL_LOCATION="$(call github,raspberrypi,linux,64d0a9870ac14d5eb5253f67d984ae348eec1393)/linux-64d0a9870ac14d5eb5253f67d984ae348eec1393.tar.gz"
BR2_LINUX_KERNEL_DEFCONFIG="bcm2711"

# Build the DTB from the kernel sources
BR2_LINUX_KERNEL_DTS_SUPPORT=y
BR2_LINUX_KERNEL_INTREE_DTS_NAME="bcm2711-rpi-4-b"

BR2_LINUX_KERNEL_NEEDS_HOST_OPENSSL=y

BR2_PACKAGE_RPI_FIRMWARE=y
BR2_PACKAGE_RPI_FIRMWARE_VARIANT_PI4=y

# Required tools to create the SD image
BR2_PACKAGE_HOST_DOSFSTOOLS=y
BR2_PACKAGE_HOST_GENIMAGE=y
BR2_PACKAGE_HOST_MTOOLS=y

# Filesystem / image
BR2_TARGET_ROOTFS_EXT2=y
BR2_TARGET_ROOTFS_EXT2_4=y
BR2_TARGET_ROOTFS_EXT2_SIZE="120M"
# BR2_TARGET_ROOTFS_TAR is not set
# BR2_ROOTFS_POST_BUILD_SCRIPT="board/raspberrypi4/post-build.sh" # Set in custom config
# BR2_ROOTFS_POST_IMAGE_SCRIPT="board/raspberrypi4/post-image.sh" # Set in custom config
# BR2_ROOTFS_POST_SCRIPT_ARGS="--add-miniuart-bt-overlay" # Set in custom config

### Custom config ###
# Name
BR2_TARGET_GENERIC_HOSTNAME="piwebcam"
BR2_TARGET_GENERIC_ISSUE="Your webcam at your service!"

# Set default password
BR2_TARGET_GENERIC_ROOT_PASSWD="root"

# Serial port through USB
BR2_TARGET_GENERIC_GETTY_PORT="ttyAMA0"

# Custom Config
BR2_LINUX_KERNEL_USE_CUSTOM_CONFIG=y
BR2_LINUX_KERNEL_CUSTOM_CONFIG_FILE="$(BR2_EXTERNAL_PICAM_PATH)/board/raspberrypi4cam/linux.config"

# Add firmware extras (enables camera module)
BR2_PACKAGE_RPI_FIRMWARE_X=y

# Default Filesystem
BR2_ROOTFS_OVERLAY="$(BR2_EXTERNAL_PICAM_PATH)/board/raspberrypi4cam/rootfs"

# Add SquashFS
BR2_LINUX_KERNEL_LZ4=y
BR2_TARGET_ROOTFS_SQUASHFS=y
BR2_TARGET_ROOTFS_SQUASHFS4_LZ4=y

# Post build scripts
BR2_ROOTFS_POST_BUILD_SCRIPT="$(BR2_EXTERNAL_PICAM_PATH)/board/raspberrypi4cam/post-build.sh"
BR2_ROOTFS_POST_IMAGE_SCRIPT="$(BR2_EXTERNAL_PICAM_PATH)/board/raspberrypi4cam/post-image.sh"
BR2_ROOTFS_POST_SCRIPT_ARGS="--configure-picam"

# Enable systemd to for picam service
BR2_INIT_SYSTEMD=y

# Add required packages
BR2_PACKAGE_LIBV4L=y
BR2_PACKAGE_LIBNL=y
BR2_PACKAGE_PIWEBCAM=y

# Add glibc toolchain
BR2_TOOLCHAIN_BUILDROOT_GLIBC=y

# CCache inside "output/" in order to cache it
BR2_CCACHE=y
BR2_CCACHE_DIR="$(BASE_DIR)/.ccache"
```

## package/camera-control/Config.in
```kconfig
config BR2_PACKAGE_CAMERA_CONTROL
	bool "V4L2 Camera Control"
	select BR2_PACKAGE_NCURSES
	select BR2_PACKAGE_NCURSES_WCHAR
	help
	  Install V4L2 Camera Control package

	  https://github.com/peterbay/camera-control
```

## package/picam-web/Config.in
```kconfig
config BR2_PACKAGE_PICAM_WEB
	bool "WebUI Camera Control"
	help
	  Install WebUI Camera Control package

	  https://github.com/tuyenld/picam-web
```

## package/piwebcam/Config.in
```kconfig
config BR2_PACKAGE_PIWEBCAM
	bool "Raspberry Pi UVC Webcam"
	select BR2_PACKAGE_LIBV4L_UTILS
	help
	  Install Raspberry Pi UVC Webcam package

	  https://github.com/peterbay/uvc-gadget
```

## package/rpic-raspimjpeg/Config.in
```kconfig
config BR2_PACKAGE_RPIC_RASPIMJPEG
	depends on BR2_PACKAGE_RPI_USERLAND
	bool "rpic-raspimjpeg"
	help
		Adds raspimjpeg from https://github.com/rpicopter/raspimjpeg
```

## package/soft-hwclock/Config.in
```kconfig
config BR2_PACKAGE_SOFT_HWCLOCK
	bool "Raspberry Pi soft-hwclock"
	select BR2_PACKAGE_SYSTEMD
	help
	  Install Raspberry Pi Soft HWClock package

	  https://github.com/kristjanvalur/soft-hwclock
```

## package/uvc-gadget/Config.in
```kconfig
config BR2_PACKAGE_UVC_GADGET
	bool "Libcamera UVC Gadget"
	select BR2_PACKAGE_LIBCAMERA
	select BR2_PACKAGE_LIBCAMERA_V4L2
	select BR2_PACKAGE_LIBCAMERA_PIPELINE_RASPBERRYPI
	select BR2_PACKAGE_LIBCAMERA_PIPELINE_UVCVIDEO
	select BR2_PACKAGE_LIBV4L
	select BR2_PACKAGE_LIBV4L_UTILS
	select BR2_PACKAGE_LIBJPEG
	select BR2_PACKAGE_JPEG
	help
	  Install Libcamera UVC Gadget

	  https://gitlab.freedesktop.org/camera/uvc-gadget
```
